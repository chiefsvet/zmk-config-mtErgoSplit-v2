## boards/shields/lily58/Kconfig.defconfig
```kconfig
if SHIELD_LILY58_LEFT

config ZMK_SPLIT_ROLE_CENTRAL
    default y

endif

if SHIELD_LILY58_LEFT || SHIELD_LILY58_RIGHT

config ZMK_SPLIT
    default y

endif
```

## boards/shields/lily58_custom/Kconfig.defconfig
```kconfig
if SHIELD_LILY58_CUSTOM_LEFT

config ZMK_SPLIT_ROLE_CENTRAL
    default y

config ZMK_SPLIT
    default y

endif

if SHIELD_LILY58_CUSTOM_RIGHT

config ZMK_SPLIT
    default y

endif
```

## boards/shields/lily58_custom/Kconfig.shield
```kconfig
config SHIELD_LILY58_CUSTOM_LEFT
    def_bool $(shields_list_contains,lily58_custom_left)

config SHIELD_LILY58_CUSTOM_RIGHT
    def_bool $(shields_list_contains,lily58_custom_right)
```

## boards/shields/mtergosplit/Kconfig.defconfig
```kconfig
if SHIELD_MTERGOSPLIT_LEFT

config ZMK_SPLIT_ROLE_CENTRAL
    default y

config ZMK_SPLIT
    default y

endif

if SHIELD_MTERGOSPLIT_RIGHT

config ZMK_SPLIT
    default y

endif
```

## boards/shields/mtergosplit/Kconfig.shield
```kconfig
config SHIELD_MTERGOSPLIT_LEFT
    def_bool $(shields_list_contains,mtergosplit_left)

config SHIELD_MTERGOSPLIT_RIGHT
    def_bool $(shields_list_contains,mtergosplit_right)
```
