/*
 * Copyright (c) 2020 Pete Johanson
 *
 * SPDX-License-Identifier: MIT
 */

#include "mtergosplit.dtsi"
#include <dt-bindings/pinctrl/nrf-pinctrl.h>

&kscan0 {
    col-gpios
        = <&gpio0 29 GPIO_ACTIVE_HIGH>   // D20 - col 0
        , <&gpio0 2  GPIO_ACTIVE_HIGH>   // D19 - col 1
        , <&gpio1 15 GPIO_ACTIVE_HIGH>   // D18 - col 2
        , <&gpio1 13 GPIO_ACTIVE_HIGH>   // D15 - col 3
        , <&gpio1 11 GPIO_ACTIVE_HIGH>   // D14 - col 4
        , <&gpio0 10 GPIO_ACTIVE_HIGH>   // D16 - col 5
        , <&gpio0 9  GPIO_ACTIVE_HIGH>   // D10 - col 6
        ;
};